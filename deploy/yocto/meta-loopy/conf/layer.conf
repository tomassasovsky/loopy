## deploy/yocto/meta-loopy/conf/layer.conf
```bitbake
# meta-loopy: the floor-console appliance layer (Tier 3a spike, issue #284).
BBPATH .= ":${LAYERDIR}"

BBFILES += "${LAYERDIR}/recipes-*/*/*.bb \
            ${LAYERDIR}/recipes-*/*/*.bbappend"

BBFILE_COLLECTIONS += "loopy"
BBFILE_PATTERN_loopy = "^${LAYERDIR}/"
BBFILE_PRIORITY_loopy = "10"

# Depends on oe-core, meta-raspberrypi, and meta-oe (for GTK3 etc.).
LAYERDEPENDS_loopy = "core raspberrypi openembedded-layer"
LAYERSERIES_COMPAT_loopy = "scarthgap styhead walnascar"
```
